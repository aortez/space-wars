## yocto/meta-spacewars/conf/layer.conf
```bitbake
# Layer configuration for meta-spacewars.

BBPATH .= ":${LAYERDIR}"

BBFILES += "${LAYERDIR}/recipes-*/*/*.bb \
            ${LAYERDIR}/recipes-*/*/*.bbappend"

BBFILE_COLLECTIONS += "spacewars"
BBFILE_PATTERN_spacewars = "^${LAYERDIR}/"
BBFILE_PRIORITY_spacewars = "10"

LAYERDEPENDS_spacewars = "core raspberrypi pi-base rust-bin-layer"
LAYERSERIES_COMPAT_spacewars = "scarthgap"
```
